## prj.conf
```kconfig
#
# Copyright (c) 2019 Nordic Semiconductor ASA
#
# SPDX-License-Identifier: LicenseRef-Nordic-5-Clause
#
# General config
CONFIG_ASSERT=y

# Network
CONFIG_NETWORKING=y
CONFIG_NET_NATIVE=n
CONFIG_NET_SOCKETS=y
CONFIG_NET_SOCKETS_OFFLOAD=y
CONFIG_POSIX_API=y

# Modem library
CONFIG_NRF_MODEM_LIB=y

# AT host library
CONFIG_AT_HOST_LIBRARY=y
CONFIG_UART_INTERRUPT_DRIVEN=y

# Stacks and heaps
CONFIG_MAIN_STACK_SIZE=3072
CONFIG_HEAP_MEM_POOL_SIZE=16384
CONFIG_AT_MONITOR_HEAP_SIZE=512
CONFIG_NRF_IRONSIDE_CPUCONF_SERVICE=y
```

## boards/nrf9280pdk_nrf9280_cpuapp_iron.overlay
```dts
/ {
	/* Specify uart to use for at_host */
	chosen {
		ncs,at-host-uart = &uart136;
	};
};
```

## src/main.c
```c
/*
 * Copyright (c) 2018 Nordic Semiconductor ASA
 *
 * SPDX-License-Identifier: LicenseRef-Nordic-5-Clause
 */

#include <zephyr/kernel.h>
#include <stdio.h>
#include <string.h>
#include <modem/nrf_modem_lib.h>
// #include <zephyr/drivers/uart.h>
// #include <zephyr/drivers/clock_control.h>
// #include <zephyr/drivers/clock_control/nrf_clock_control.h>

// /* To strictly comply with UART timing, enable external XTAL oscillator */
// void enable_xtal(void)
// {
// 	struct onoff_manager *clk_mgr;
// 	static struct onoff_client cli = {};

// 	clk_mgr = z_nrf_clock_control_get_onoff(CLOCK_CONTROL_NRF_SUBSYS_HF);
// 	sys_notify_init_spinwait(&cli.notify);
// 	(void)onoff_request(clk_mgr, &cli);
// }

int main(void)
{
	int err;

	printk("The AT host sample started\n");

	err = nrf_modem_lib_init();
	if (err) {
		printk("Modem library initialization failed, error: %d\n", err);
		return 0;
	}
	//enable_xtal();
	printk("Ready\n");

	return 0;
}
```
